## config/west.yml
```yaml
manifest:
  remotes:
    - name: zmkfirmware
      url-base: https://github.com/zmkfirmware
    - name: JarredSteenvoorden
      url-base: https://github.com/JarredSteenvoorden
    - name: caksoylar
      url-base: https://github.com/caksoylar
  projects:
    - name: zmk
      remote: JarredSteenvoorden
      revision: caksoylar/zen-v1+v2-left-icon
      import: app/west.yml
  self:
    path: config
```
